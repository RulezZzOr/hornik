## buildroot/configs/s19_aml_defconfig
```kconfig
BR2_EXTERNAL_OPENMINEROS_PATH="$(BR2_EXTERNAL)"
BR2_TARGET_GENERIC_HOSTNAME="openmineros-s19-aml"
BR2_SYSTEM_DHCP="eth0"
BR2_PACKAGE_DROPBEAR=y
BR2_PACKAGE_DROPBEAR_DISABLE_REVERSEDNS=y
```
